OUTPUT_FORMAT("elf64-x86-64", "elf64-x86-64", "elf64-x86-64")
OUTPUT_ARCH(i386:x86-64)
ENTRY(__kern_entry)

KERNEL_BASE = 0xFFFFFFFF80000000;

SECTIONS {

	. = KERNEL_BASE;

	.bootinfo : { *bootinfo.o(.*) }

	. = ALIGN(0x1000);
	PROVIDE(__kern_text_start = .);

    .text : {
        *(.text .stub .text.* .gnu.linkonce.t.*)
    }

	. = ALIGN(0x1000);
	PROVIDE(__kern_ro_start = .);
    .rodata : {
        *(.rodata .rodata.* .gnu.linkonce.r.*)
    }

	. = ALIGN(0x1000);
	PROVIDE(__kern_pls_start = .);
	.pls : {
		 *(.pls)
	}

	. = ALIGN(0x1000);
	PROVIDE(__kern_data_start = .);
    .data : {
        *(.data)
    }

	. = ALIGN(0x1000);
	PROVIDE(__kern_bss_start = .);
    .bss : {
        *(.bss)
    }

	. = ALIGN(0x1000);
	PROVIDE(__kern_end = .);

    /DISCARD/ : {
        *(.eh_frame .note.GNU-stack)
    }
}
