## ucore/src/kern-ucore/arch/x86_64/Kconfig
```kconfig
source src/kern-ucore/Kconfig
source src/kern-ucore/mm/Kconfig
source src/kern-ucore/schedule/Kconfig
source src/kern-ucore/fs/Kconfig
source src/kern-ucore/module/Kconfig
```

## ucore/src/kern-ucore/mm/Kconfig
```kconfig
menu "Memory Management"

config SWAP
	bool "Support for paging of anonymous memory (swap)"
	default y
	help
		Enable support for providing more virtual memory than actual RAM
		present by using disk storage.

choice
  prompt "Heap"
  default HEAP_SLAB

config HEAP_SLAB
  bool "SLAB"

config HEAP_SLOB
  bool "SLOB"

endchoice

endmenu
```
